## br2_external/configs/raspberrypi3_network_defconfig
```kconfig
BR2_arm=y
BR2_cortex_a53=y
BR2_ARM_FPU_NEON_VFPV4=y
BR2_PACKAGE_HOST_LINUX_HEADERS_CUSTOM_4_19=y
BR2_TOOLCHAIN_BUILDROOT_CXX=y
BR2_TOOLCHAIN_GLIBC_GCONV_LIBS_COPY=y
BR2_CCACHE=y
BR2_CCACHE_DIR="$(BASE_DIR)/.buildroot-ccache"
BR2_OPTIMIZE_3=y
BR2_SHARED_STATIC_LIBS=y
BR2_GLOBAL_PATCH_DIR="$(BR2_EXTERNAL_PIEJAM_PATH)/patches $(BR2_EXTERNAL_PIEJAM_PATH)/board/raspberrypi3/patches"
BR2_TARGET_GENERIC_HOSTNAME="piejam"
BR2_TARGET_GENERIC_ISSUE="Welcome to PieJam"
BR2_SYSTEM_BIN_SH_BASH=y
BR2_SYSTEM_DHCP="eth0"
BR2_ROOTFS_OVERLAY="$(BR2_EXTERNAL_PIEJAM_PATH)/board/raspberrypi-common/rootfs $(BR2_EXTERNAL_PIEJAM_PATH)/board/raspberrypi3/rootfs $(BR2_EXTERNAL_PIEJAM_PATH)/board/raspberrypi/network/rootfs-overlay"
BR2_ROOTFS_POST_IMAGE_SCRIPT="$(BR2_EXTERNAL_PIEJAM_PATH)/board/raspberrypi3/post-image.sh"
BR2_LINUX_KERNEL=y
BR2_LINUX_KERNEL_CUSTOM_TARBALL=y
BR2_LINUX_KERNEL_CUSTOM_TARBALL_LOCATION="$(call github,raspberrypi,linux,rpi-4.19.y)/linux-rpi-4.19.y.tar.gz"
BR2_LINUX_KERNEL_USE_CUSTOM_CONFIG=y
BR2_LINUX_KERNEL_CUSTOM_CONFIG_FILE="$(BR2_EXTERNAL_PIEJAM_PATH)/board/raspberrypi3/linux.config"
BR2_LINUX_KERNEL_CONFIG_FRAGMENT_FILES="$(BR2_EXTERNAL_PIEJAM_PATH)/board/raspberrypi/network/linux-kernel-network.config"
BR2_LINUX_KERNEL_LZ4=y
BR2_LINUX_KERNEL_DTS_SUPPORT=y
BR2_LINUX_KERNEL_INTREE_DTS_NAME="bcm2710-rpi-2-b bcm2710-rpi-3-b bcm2710-rpi-3-b-plus overlays/rpi-ft5406-overlay overlays/disable-bt-overlay overlays/rpi-backlight-overlay"
BR2_LINUX_KERNEL_DTB_OVERLAY_SUPPORT=y
BR2_PACKAGE_BUSYBOX_CONFIG="$(BR2_EXTERNAL_PIEJAM_PATH)/board/raspberrypi-common/busybox.config"
BR2_PACKAGE_BUSYBOX_SHOW_OTHERS=y
BR2_PACKAGE_PSPLASH_IMAGE="$(BR2_EXTERNAL_PIEJAM_PATH)/boot_logo.png"
# BR2_PACKAGE_PSPLASH_PROGRESS_BAR is not set
BR2_PACKAGE_RPI_FIRMWARE_BOOTCODE_BIN=y
BR2_PACKAGE_RPI_FIRMWARE_VARIANT_PI=y
BR2_PACKAGE_RPI_FIRMWARE_CONFIG_FILE="$(BR2_EXTERNAL_PIEJAM_PATH)/board/raspberrypi3/rpi-firmware/config.txt"
BR2_PACKAGE_RPI_FIRMWARE_CMDLINE_FILE="$(BR2_EXTERNAL_PIEJAM_PATH)/board/raspberrypi3/rpi-firmware/cmdline.txt"
# BR2_PACKAGE_RPI_FIRMWARE_INSTALL_DTB_OVERLAYS is not set
BR2_PACKAGE_RPI_USERLAND=y
# BR2_PACKAGE_IFUPDOWN_SCRIPTS is not set
BR2_TARGET_ROOTFS_EXT2=y
BR2_TARGET_ROOTFS_EXT2_4=y
BR2_TARGET_ROOTFS_EXT2_SIZE="160M"
# BR2_TARGET_ROOTFS_TAR is not set

# Network features
# ========================================
# Network Features Configuration Fragment
# ========================================
# Append this to base defconfig for network variant

# WiFi Firmware
BR2_PACKAGE_BRCMFMAC_SDIO_FIRMWARE_RPI=y
BR2_PACKAGE_BRCMFMAC_SDIO_FIRMWARE_RPI_WIFI=y

# WiFi Management (lightweight)
BR2_PACKAGE_WPA_SUPPLICANT=y
BR2_PACKAGE_WPA_SUPPLICANT_NL80211=y
BR2_PACKAGE_WPA_SUPPLICANT_CLI=y
BR2_PACKAGE_WPA_SUPPLICANT_PASSPHRASE=y
BR2_PACKAGE_IW=y
BR2_PACKAGE_WIRELESS_REGDB=y

# Dynamic device handling
BR2_ROOTFS_DEVICE_CREATION_DYNAMIC_MDEV=y

# NFS Server
BR2_PACKAGE_NFS_UTILS=y
BR2_PACKAGE_NFS_UTILS_RPC_NFSD=y
BR2_PACKAGE_NFS_UTILS_RPC_MOUNTD=y
BR2_PACKAGE_NFS_UTILS_EXPORTFS=y
BR2_PACKAGE_RPCBIND=y

# Optional: Lightweight SSH (comment out if not wanted)
BR2_PACKAGE_DROPBEAR=y
BR2_PACKAGE_DROPBEAR_DISABLE_REVERSEDNS=y
BR2_PACKAGE_DROPBEAR_SMALL=y
```
